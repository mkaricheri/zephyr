## samples/subsys/fs/littlefs/boards/stm32h747i_disco_m7.conf
```kconfig
CONFIG_COMMON_LIBC_MALLOC_ARENA_SIZE=8192
CONFIG_SDMMC_STM32=y
CONFIG_SHELL=y
CONFIG_FILE_SYSTEM_SHELL=y
CONFIG_SDMMC_STM32_HWFC=y
CONFIG_SHELL_STACK_SIZE=4096
CONFIG_HEAP_MEM_POOL_SIZE=4096
CONFIG_FS_LITTLEFS_FC_HEAP_SIZE=8192
CONFIG_NEWLIB_LIBC=y
CONFIG_MAIN_STACK_SIZE=4096
CONFIG_COMMON_LIBC_MALLOC=y
CONFIG_CACHE_MANAGEMENT=y
```
